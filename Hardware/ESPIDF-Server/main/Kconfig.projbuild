## Hardware/ESPIDF-Server/main/Kconfig.projbuild
```kconfig
menu "Example Configuration"

    config BROKER_URL
        string "Broker URL"
        default "mqtt://93.155.224.232:5728"
        help
            URL of the broker to connect to

    config BROKER_URL_FROM_STDIN
        bool
        default y if BROKER_URL = "FROM_STDIN"

endmenu
```

## Hardware/ESPIDF-Server/sdkconfig.defaults
```kconfig
CONFIG_MQTT_PROTOCOL_5=y
CONFIG_FREERTOS_HZ=1000
CONFIG_IDF_TARGET="esp32s3"
CONFIG_AUTOSTART_ARDUINO=y

# BLE Config
CONFIG_BT_ENABLED=y
CONFIG_BT_BLUEDROID_ENABLED=n
CONFIG_BT_NIMBLE_ENABLED=y
```
